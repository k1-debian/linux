## module_drivers/drivers/video/fbdev/ingenic/fb_stage/Kconfig
```kconfig
menuconfig FB_INGENIC_STAGE
	tristate "Ingenic Framebuffer Driver for stage"
	depends on FB_INGENIC
	select FB_INGENIC_DISPLAYS_STAGE
	select FB_CFB_FILLRECT
	select FB_CFB_COPYAREA
	select FB_CFB_IMAGEBLIT
	help
	  Framebuffer support for the Version 12 DPU SoC.
config HW_COMPOSER_V4L2_M2M
	bool "support composer v4l2mem device"
	depends on FB_INGENIC_STAGE
	select V4L2_MEM2MEM_DEV
	select VIDEOBUF2_DMA_CONTIG_INGENIC
	default n
	help
		This config composer use for v4l2 device
config FB_USING_CACHABLE
	bool "using cacheable framebuffers, will flush cache when call pan_display."
	depends on FB_INGENIC_STAGE
	default n
	help
		Using Cacheable mmap to userspace.
```

## module_drivers/drivers/video/ingenic-jpeg/Kconfig
```kconfig
menuconfig JZ_JPEG
	bool "[JPEG] JZ jpeg unit"
	depends on SOC_X2600 || SOC_AD100
	default n

config INGENIC_JPEG_DEC
	tristate "Ingenic jpeg decoder Driver"
	depends on JZ_JPEG
	default n
	help
	  Support for Ingenic jpeg-dec operations.

config INGENIC_JPEG_ENC
	tristate "Ingenic jpeg encoder Driver"
	depends on JZ_JPEG
	default n
	help
	  Support for Ingenic jpeg-enc operations.
```

## module_drivers/drivers/video/ingenic_S2D/Kconfig
```kconfig
config INGENIC_S2D
	tristate "Ingenic S2D Driver"
	depends on SOC_X2600 || SOC_AD100
	default n
	help
	  Support for Ingenic simple image 2d operations.
```
