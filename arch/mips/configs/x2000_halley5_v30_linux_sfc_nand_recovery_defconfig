## module_drivers/drivers/media/platform/ingenic-isp/Kconfig
```kconfig
config ISP_DUMP
    bool "Enable isp dump feature"
    default y
	depends on VIDEO_INGENIC_ISP
    help
        Enable this option to generate sysfs attributes for isp dump.

config VIC_DUMP
	bool "Enable vic dump feature"
	default y
	depends on VIDEO_INGENIC_ISP
	help
		Enable this option to generate sysfs attributes for vic dump.

config VIC_DMA_ROUTE
	bool "vic dma out route enable"
	default y
	depends on VIDEO_INGENIC_ISP

config MSCA_DUMP
	bool "Enable mscaler dump feature"
	default y
	depends on VIDEO_INGENIC_ISP
	help
		Enable this option to generate sysfs attributes for mscaler dump.

config CSI_DUMP
	bool "Enable csi dump feature"
	default y
	depends on VIDEO_INGENIC_ISP
	help
		Enable this option to generate sysfs attributes for csi dump.

# halley5 board
menuconfig HALLEY5_CAMERA_BOARD
	bool "halley5_camera_board"
	depends on VIDEO_INGENIC_ISP
	default n
	help
	  Say Y here to enable support for halley5_camera_boards.

config RD_X2000_HALLEY5_CAMERA_4V2
	bool "halley5 camera driver for RD_X2000_HALLEY5_CAMERA_4V2"
	depends on HALLEY5_CAMERA_BOARD
	select INGENIC_ISP_CAMERA_OV2735B
	select INGENIC_ISP_CAMERA_OV2735A

config RD_X2000_HALLEY5_CAMERA_4V3
	bool "halley5 camera driver for RD_X2000_HALLEY5_CAMERA_4V3"
	depends on HALLEY5_CAMERA_BOARD
	select INGENIC_ISP_CAMERA_OV2735A
	select V4L2_FWNODE

config RD_X2000_HALLEY5_CAMERA_6V0
	bool "halley5 camera driver for RD_X2000_HALLEY5_CAMERA_6V0"
	depends on HALLEY5_CAMERA_BOARD
	select INGENIC_ISP_CAMERA_SC230AI
	select V4L2_FWNODE

config RD_X2000_HALLEY5_CAMERA_3V2
	bool "halley5 camera driver for RD_X2000_HALLEY5_CAMERA_3V2"
	depends on HALLEY5_CAMERA_BOARD
	select INGENIC_ISP_CAMERA_OV4689

choice
	prompt "ov4689 resolution and frame rate select"
	depends on RD_X2000_HALLEY5_CAMERA_3V2
	default OV4689_1080P_30FPS
	help
	Select ov4689 sensor's resolution and frame rate that driver supported.

config OV4689_1080P_120FPS
	bool "OV4689_1080P_120fps"
	depends on RD_X2000_HALLEY5_CAMERA_3V2 || CAMERA_V10

config OV4689_1080P_30FPS
	bool "OV4689_1080P_30fps"
	depends on RD_X2000_HALLEY5_CAMERA_3V2 || CAMERA_V10

config OV4689_2048X1520_30FPS
	bool "ov4689_2048x1520_30fps"
	depends on RD_X2000_HALLEY5_CAMERA_3V2 || CAMERA_V10
endchoice

config RD_X2000_HALLEY5_CAMERA_5V0
	bool "halley5 camera driver for RD_X2000_HALLEY5_CAMERA_5V0"
	depends on HALLEY5_CAMERA_BOARD
	select INGENIC_ISP_CAMERA_AR0144

config RD_X2000_HALLEY5_CAMERA_7V0
	bool "halley5 camera driver for RD_X2000_HALLEY5_CAMERA_7V0"
	depends on HALLEY5_CAMERA_BOARD
	select INGENIC_ISP_CAMERA_GC2053

config HALLEY5_CAMERA_BOARDS_AUTO_MATCH
	bool "auto match halley5 camera boards - CAMERA_4V3/CAMERA_5V0/CAMERA_7V0"
	depends on HALLEY5_CAMERA_BOARD
	select INGENIC_ISP_CAMERA_OV2735A
	select INGENIC_ISP_CAMERA_GC2053
	select INGENIC_ISP_CAMERA_AR0144

# gewu board
menuconfig GEWU_CAMERA_BOARD
	bool "gewu_camera_board"
	depends on VIDEO_INGENIC_ISP
	default n
	help
	  Say Y here to enable support for gewu_camera_boards.

config CAMERA_V10
	bool "gewu camera driver for CAMERA_1.0"
	depends on GEWU_CAMERA_BOARD
	select INGENIC_ISP_CAMERA_OV4689

choice
	prompt "ov4689 resolution and frame rate select"
	depends on CAMERA_V10
	default GEWU_OV4689_1080P_30FPS
	help
	Select ov4689 sensor's resolution and frame rate that driver supported.

config GEWU_OV4689_1080P_120FPS
	bool "OV4689_1080P_120fps"
	select OV4689_1080P_120FPS
	depends on CAMERA_V10

config GEWU_OV4689_1080P_30FPS
	bool "OV4689_1080P_30fps"
	select OV4689_1080P_30FPS
	depends on CAMERA_V10

config GEWU_OV4689_2048X1520_30FPS
	bool "ov4689_2048x1520_30fps"
	select OV4689_2048X1520_30FPS
	depends on CAMERA_V10
endchoice
```

## module_drivers/drivers/media/platform/ingenic-vcodec/Kconfig
```kconfig
config VIDEO_INGENIC_VCODEC
        tristate "V4L2 driver for ingenic Video Codec"
        depends on VIDEO_DEV && VIDEO_V4L2_I2C
        select V4L2_MEM2MEM_DEV
        select VIDEOBUF2_DMA_CONTIG_INGENIC
        select VIDEOBUF2_DMA_CONTIG

config INGENIC_HELIX
	tristate "[ENC] ingenic video helix"
	depends on VIDEO_INGENIC_VCODEC

choice
	prompt "H264E RC Method"
	depends on INGENIC_HELIX
	default INGENIC_HELIX_H264E_RC_NETLINK

config INGENIC_HELIX_H264E_RC_NETLINK
	bool "H264E RC algrithom run in user througth Netlink"
	help
		need h264e-nl-server run in userspace.

config INGENIC_HELIX_H264E_RC_IN_KERNEL
	bool "H264E RC algrithom run in kernel"
	help
		RC algrithom run in kernel direct.
endchoice

config INGENIC_FELIX
	tristate "[DEC] ingenic video felix"
	depends on VIDEO_INGENIC_VCODEC
	select V4L2_FWNODE

config FELIX_INIT_BY_USER
    bool "felix init triggered by user"
    depends on INGENIC_FELIX
```

## module_drivers/drivers/mtd/Kconfig
```kconfig
if MTD

config MTD_BLOCK_BBT_RO
	tristate "Bad block tab based readonly block device access to MTD devices, "
	depends on BLOCK
	select MTD_BLKDEVS
	help
	  This allows you to mount read-only file systems (such as squashfs)
	  There is a bad block tab to skip the bad block on nand for readonly use.
	  It's a sample bad block tab, create at init, so you'd better don't write
	  the nand at runtime.

config MTD_BLOCK_BBT_RO_BLOCK_SIZE
	int "block size of /dev/mtdblock_bbt_ro"
	depends on MTD_BLOCK_BBT_RO
	default 4096

endif # MTD
```

## module_drivers/drivers/net/wireless/Kconfig
```kconfig
source "module_drivers/drivers/net/wireless/bcmdhd/Kconfig"
source "module_drivers/drivers/net/wireless/bl602/Kconfig"
#source "module_drivers/drivers/net/wireless/realtek/rtl8723ds/Kconfig"
```

## module_drivers/drivers/net/wireless/bl602/Kconfig
```kconfig
config WIRELESS_BL602
	tristate "BL602 FullMAC wireless cards support"
	help
	  This module adds support for wireless adapters based on
	  BL602 FullMAC chipset.
```

## module_drivers/drivers/remoteproc/Kconfig
```kconfig
config INGENIC_MCU_RPROC
    tristate "ingenic mcu remoteproc support"
    depends on HAS_DMA
    select REMOTEPROC
    default n
    help
      Say y or m here to support ingenic mcu remoteproc.
      This can be either built-in or a loadable module.
      This module needs to be used with the mcu-host application.
      If unsure say N.

config INGENIC_MCU_IPC
    bool "mcu Inter-processor communication support"
    depends on INGENIC_MCU_RPROC
    select INGENIC_RPROC_IPC
    help
      Say y or m here to support mcu Inter-processor communication with xburst2.

config INGENIC_RISCV_RPROC
    tristate "ingenic riscv remoteproc support"
    depends on SOC_X2500 || SOC_X2600
    select REMOTEPROC
    default n

config INGENIC_RISCV_IPC
    bool "riscv Inter-processor communication support"
    depends on INGENIC_RISCV_RPROC
    select INGENIC_RPROC_IPC
    help
      Say y or m here to support riscv Inter-processor communication with xburst2.

config INGENIC_RPROC_IPC
    bool
    default n
    depends on INGENIC_MCU_IPC || INGENIC_RISCV_IPC
```

## module_drivers/drivers/rpmsg/Kconfig
```kconfig
config INGENIC_RPMSG
        tristate "ingenic rpmsg support"
        select RPMSG_VIRTIO
        default n
        help
          Say y or m here to support ingenic rpmsg.
          This can be either built-in or a loadable module.
          If unsure say N.
```

## module_drivers/drivers/sc/Kconfig
```kconfig
#
# JZ_SECURITY driver configuration
#
# NOTE:
#
config INGENIC_SC
	bool "Ingenic Security support"
```

## module_drivers/drivers/usb/misc/Kconfig
```kconfig
comment "USB Miscellaneous drivers"

if USB
config USB_LOADER
	tristate "USB LOADER Driver"
	help
	  Say Y here if you want to load firmware to another Ingenic Chip via usbboot.

	  To compile this driver as a module, choose M here: the
	  module will be called usbloader.

endif #USB
```

## module_drivers/drivers/usb/phy/Kconfig
```kconfig
config INGENIC_USB_PHY
	tristate "Ingenic USB Physical Layer Drivers"
	select USB_PHY
	help
	  Enable this to support Ingenic USB phy helper driver for ingenic SoCs.
	  This driver provides common interface to interact, typically used for INGENIC SOCs.
```

## module_drivers/drivers/video/fbdev/ingenic-vo/Kconfig
```kconfig
config INGENIC_VO
	tristate "[VO] ingenic VO bt1120 output"
	depends on SOC_X2500 && FB
	select FB_CFB_FILLRECT
	select FB_CFB_COPYAREA
	select FB_CFB_IMAGEBLIT
	select FB_SYS_FOPS
	default n
	help
		this driver is used for VO module, which support bt1120 output as a framebuffer driver.
```

## module_drivers/drivers/video/fbdev/ingenic/Kconfig
```kconfig
menuconfig FB_INGENIC
	tristate "Ingenic Framebuffer Driver"
	depends on FB
	select FB_CFB_FILLRECT
	select FB_CFB_COPYAREA
	select FB_CFB_IMAGEBLIT
	help
		LCD Driver for INGENIC

config FB_INGENIC_DUMP
	bool "Ingenic Framebuffer Driver Debug"
	depends on FB_INGENIC

config FB_VSYNC_SKIP_DISABLE
        bool "Disable Vsync skip"
        depends on FB_INGENIC
        help
          Disable Vsync skip

config FB_VSYNC_SKIP
        int "Vsync skip ratio[0..9]"
        depends on FB_INGENIC
        default 9
        help
          Vsync skip ratio

config FB_INGENIC_NR_FRAMES
	int "how many frames support"
	depends on FB_INGENIC
	default 3

config FB_INGENIC_NR_LAYERS
	int "how many layers support"
	depends on FB_INGENIC
	default 4

config FB_INGENIC_DUMP
        bool "fb test for displaying color bar"
        depends on FB_INGENIC
        default n
        help
           fb test for displaying color bar in your board.

config ROT_INGENIC
	tristate "X2600 Rotator"
	depends on SOC_X2600
	depends on FB_INGENIC
        default y
	help
	  This is the image rotation function of the x2600 series chip.

config ROT_INGENIC_BUFS
	int "how many rot buf support"
	depends on ROT_INGENIC
	default 2

config SLCDC_CONTINUA
    tristate "SLCDC CONTINUA TRANFER"
    depends on FB_INGENIC
    default n

config SLCDC_USE_TE
	tristate "SLCDC USE TE SIGNAL"
	depends on FB_INGENIC
	default n

config FB_INGENIC_MIPI_DSI
	bool "ingenic mipi dsi interface"
	depends on FB_INGENIC_V12
	default n


if FB_INGENIC
#source "module_drivers/drivers/video/fbdev/ingenic/spi_fb_v12/Kconfig"
source "module_drivers/drivers/video/fbdev/ingenic/fb_stage/Kconfig"
source "module_drivers/drivers/video/fbdev/ingenic/fb_stage_wip/Kconfig"
source "module_drivers/drivers/video/fbdev/ingenic/displays/Kconfig"
endif
```
