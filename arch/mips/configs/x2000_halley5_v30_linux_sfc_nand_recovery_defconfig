## arch/mips/xburst/soc-x1000/Kconfig.DT
```kconfig
choice
	prompt "device tree select for X1000 boards"
	default DT_X1000_MODULE_BASE
	depends on SOC_X1000

config DT_X1000_MODULE_BASE
	bool "X1000 module base"

endchoice

config DT_X1000_MODULE_BASE_DTS_FILE
    string "dts file for x1000 module driver"
    depends on DT_X1000_MODULE_BASE
    default "x1000_module_base.dts"
    help
        the dts file location is "arch/mips/boot/dts/ingenic/"
```

## arch/mips/xburst/soc-x1600/Kconfig.DT
```kconfig
choice
	prompt "device tree select for X1600 boards"
	default DT_HALLEY6_V10
	depends on SOC_X1600

config DT_X1600_MODULE_BASE
	bool "x1600 module base"

config DT_PANDA_V10
	bool "x1600 panda v10"

config DT_HALLEY6_V10
	bool "x1600 halley6 v10"

config DT_HALLEY6_V20
	bool "x1600 halley6 v20"
config DT_HALLEY6_V20_SEEKWAVE
	bool "x1600 halley6 v20 seekwave wifi&bt"

endchoice

config DT_X1600_MODULE_BASE_DTS_FILE
    string "dts file for x1600 module driver"
    depends on DT_X1600_MODULE_BASE
    default "x1600_module_base.dts"
    help
        the dts file location is "arch/mips/boot/dts/ingenic/"
```

## arch/mips/xburst2/soc-ad100/Kconfig.DT
```kconfig
choice
	prompt "device tree select for AD100 boards"
	depends on SOC_AD100

config DT_AD100_MODULE_BASE
	bool "ad100 module base"

endchoice

config DT_AD100_MODULE_BASE_DTS_FILE
	string "dts file for ad100 module driver"
	depends on DT_AD100_MODULE_BASE
	default "ad100_module_base.dts"
	help
		the dts file location is module_drivers/dts/
```

## arch/mips/xburst2/soc-x2000/Kconfig.DT
```kconfig
choice
	prompt "device tree select for X2000 X2100 boards"
	depends on SOC_X2000 || SOC_X2100

config DT_X2000_MODULE_BASE
       bool "x2000 module base"

config DT_HALLEY5_V30
       bool "x2000 halley5_v30"

config DT_CREALITY_K1
       bool "x2000 Creality K1"

config DT_ZEBRA
       bool "x2000 zebra"

config DT_KALE_V10
       bool "x2100 kale_v10"
endchoice

config DT_X2000_MODULE_BASE_DTS_FILE
	string "dts file for X2000 module driver"
	depends on DT_X2000_MODULE_BASE
	default "x2000_module_base.dts"
	help
		the dts file location is arch/mips/boot/dts/ingenic/
```

## arch/mips/xburst2/soc-x2600/Kconfig.DT
```kconfig
choice
	prompt "device tree select for X26xx boards"
	depends on SOC_X2600

config DT_X2600_MODULE_BASE
	bool "x2600 module base"
config DT_X2660_EVB
	bool "x2660 evb board"
config DT_X2600_TUCANA
	bool "x2600 tucana board"
config DT_X2600_HALLEY7
	bool "x2600_halley7 v1.0/v1.1 board"
config DT_X2670_HARE
	bool "x2670_hare board"
config DT_XBURST2_EXTERNAL_BOARD
	bool "xburst2 external board."
endchoice

config DT_X2600_MODULE_BASE_DTS_FILE
	string "dts file for X2600 module driver"
	depends on DT_X2600_MODULE_BASE
	default "x2600_module_base.dts"
	help
		the dts file location is arch/mips/boot/dts/ingenic/
```

## module_drivers/drivers/Kconfig
```kconfig
comment "---- Minimal required Drivers ----"
menu "[Interrupt] Drivers"
source "module_drivers/drivers/irqchip/Kconfig"
endmenu

menu "[OST] clocksoure Drivers"
source "module_drivers/drivers/clocksource/Kconfig"
endmenu

menu "[CPM] clk Drivers"
source "module_drivers/drivers/clk/ingenic-v2/Kconfig"
endmenu

menu "[GPIO] Pinctroller Drivers"
source "module_drivers/drivers/pinctrl/Kconfig"
endmenu

menu "[UART] Drivers"
source "module_drivers/drivers/tty/serial/Kconfig"
endmenu

menu "[MSC] (eMMC/SD/SDIO) and Device Drivers"
source "module_drivers/drivers/mmc/host/Kconfig"
endmenu

menu "[DMA] Drivers"
source "module_drivers/drivers/dma/ingenic/Kconfig"
endmenu

menu "[SFC] (SPI Nand/Nor Flash) Drivers"
source "module_drivers/drivers/mtd/devices/Kconfig"
endmenu

source "module_drivers/drivers/sc/Kconfig"

menu "[SPI] Master/Slave Drivers"
source "module_drivers/drivers/spi/Kconfig"
endmenu

menu "[I2C] Master Drivers"
source "module_drivers/drivers/i2c/busses/Kconfig"
endmenu

comment "---- minimal OS requirements. ----"

menu "[LCD] Panel/Touchscreen Drivers"

source "module_drivers/drivers/video/fbdev/ingenic/Kconfig"
source "module_drivers/drivers/video/logo-ingenic/Kconfig"

menu "Touchscreen Drivers"
source "module_drivers/drivers/input/touchscreen/Kconfig"
endmenu
endmenu

source "module_drivers/drivers/video/fbdev/ingenic-vo/Kconfig"


menu "[GMAC] (ethernet) Drivers"
source "module_drivers/drivers/net/ethernet/ingenic/Kconfig"
endmenu
menu "[WIFI]  Drivers"
source "module_drivers/drivers/net/wireless/bcmdhd_1_363_125_17/Kconfig"
source "module_drivers/drivers/net/wireless/bcmdhd_101_10_591_x/Kconfig"
source "module_drivers/drivers/net/wireless/bl602/Kconfig"
source "module_drivers/drivers/net/wireless/realtek/rtl8723ds/Kconfig"
source "module_drivers/drivers/net/wireless/realtek/rtl8189fs/Kconfig"
endmenu

menu "[CAN] (ethernet) Drivers"
depends on SOC_X1600 || SOC_X2600
source "module_drivers/drivers/net/can/ingenic/Kconfig"
endmenu

comment "---- (V4L2) Media Device Drivers ----"
source "module_drivers/drivers/media/common/videobuf2/Kconfig"
source "module_drivers/drivers/media/platform/Kconfig"
menu "[Sensors] Camera Sensors"
source "module_drivers/drivers/media/i2c/Kconfig"
endmenu

source "module_drivers/drivers/video/ingenic_bscaler/Kconfig"
source "module_drivers/drivers/video/ingenic-nna/Kconfig"
source "module_drivers/drivers/video/ingenic_ipu/Kconfig"
source "module_drivers/drivers/video/ingenic_avpu/Kconfig"
source "module_drivers/drivers/video/ingenic-jpeg/Kconfig"
source "module_drivers/drivers/video/ingenic_S2D/Kconfig"


comment "---- MISC Device Drivers ----"
source "module_drivers/drivers/misc/Kconfig"

source "module_drivers/drivers/char/Kconfig"

comment "[MFD] Multi Function Device Drivers"
source "module_drivers/drivers/mfd/Kconfig"

comment "[Power] power and regulator Drivers"
#source "module_drivers/drivers/power/Kconfig"
#source "module_drivers/drivers/regulator/Kconfig"

source "module_drivers/drivers/crypto/Kconfig"


menu "[WDT] watchdog Drivers"
source "module_drivers/drivers/watchdog/Kconfig"
endmenu

menu "[MTD] drivers"
source "module_drivers/drivers/mtd/Kconfig"
endmenu

menu "[PWM] drivers"
source "module_drivers/drivers/pwm/Kconfig"
endmenu

menu "[RTC] drivers"
source "module_drivers/drivers/rtc/Kconfig"
endmenu

menu "[CPUFREQ] drivers"
source "module_drivers/drivers/cpufreq/Kconfig"
endmenu

menu "[Remoteproc] drivers"
source "module_drivers/drivers/remoteproc/Kconfig"
endmenu

menu "[Rpmsg] drivers"
source "module_drivers/drivers/rpmsg/Kconfig"
endmenu

menu "[iio] drivers"
depends on SOC_X2600
source "module_drivers/drivers/iio/adc/Kconfig"
endmenu

menu "[dmabuf heap] drivers"
source "module_drivers/drivers/dma-buf/heaps/Kconfig"
endmenu

menu "[USB] Drivers"
source "module_drivers/drivers/usb/misc/Kconfig"
source "module_drivers/drivers/usb/phy/Kconfig"
endmenu
```

## module_drivers/drivers/char/Kconfig
```kconfig
config INGENIC_CDBUS
	bool "[CDBUS] Ingenic Cdbus Driver"
	depends on SOC_X1600
	default y
	help
		Say Y here if you want to use cdbus communication function.
		when in doubt , Say N here.

config INGENIC_NEMC
	bool "[NEMC] Ingenic Nemc Driver"
	default n
	help
		Say Y here if you want to use cdbus communication function.
		when in doubt , Say N here.

config INGENIC_PWM_AUDIO
	bool "[PWM-AUDIO] Ingenic Pwm Audio Driver"
	depends on PWM_INGENIC_V3
	default n
	help
		Say Y here if you want to use pwm audio function.
		when in doubt , Say N here.

config INGENIC_PWM_SMC
	bool "[PWM-SMC] Ingenic Pwm SMC Driver"
	depends on PWM_INGENIC_V3
	default n
	help
		Say Y here if you want to use pwm scan function.
		when in doubt , Say N here.

config INGENIC_HW_RANDOM
        tristate "[RANDOM] Ingenic Random Driver"
        depends on MIPS
        help
         This driver provides kernel-side support for the Random Number
         Generator hardware found on Ingenic processors.

         To compile this driver as a module, choose M here: the
         module will be called ingenic-rng.

         If unsure, say N.
```

## module_drivers/drivers/cpufreq/Kconfig
```kconfig
config X2000_CPUFREQ
	tristate "x2000 CPUFreq Driver"
	depends on SOC_X2000 || SOC_X2100
	select  PM_OPP
	select	CPU_FREQ
	select  CPU_FREQ_STAT
	select  CPU_FREQ_DEFAULT_GOV_PERFORMANCE
	select  CPU_FREQ_GOV_POWERSAVE
	select  CPU_FREQ_GOV_USERSPACE
	select  CPU_FREQ_GOV_ONDEMAND
	select  CPU_FREQ_GOV_CONSERVATIVE
	select  CPU_FREQ_GOV_SCHEDUTIL
	help
	  This option adds a CPUFreq driver for ingenic processors which
	  support software configurable cpu frequency.

	  X2000 and it's successors support this feature.

	  For details, take a look at <file:Documentation/cpu-freq/>.
```

## module_drivers/drivers/dma-buf/heaps/Kconfig
```kconfig
config DMABUF_HEAPS_RESERVEMEM
	bool "DMA-BUF Reserve Memory Heap"
	depends on DMABUF_HEAPS
	help
	  Choose this option to enable the reserve memory dmabuf heap. The reserve memory heap
	  is backed by dma coherence allocate. If in doubt, say Y.
```

## module_drivers/drivers/iio/adc/Kconfig
```kconfig
config INGENIC_SADC
	tristate "[X2600 SADC] X2600 sadc iio driver."
	depends on SOC_X2600
	select IIO
	select IIO_BUFFER
	select IIO_TRIGGER
	select IIO_TRIGGERED_BUFFER
	select IIO_SYSFS_TRIGGER
	default n
	help
	    Say yes here to build support for x2600 sadc device .
config ADC_DEBUG
	tristate "[DEBUG] DEBUG sadc iio driver."
	default n
	help
		Say yes here to DEBUG x2600 sadc device.
```

## module_drivers/drivers/media/common/videobuf2/Kconfig
```kconfig
config VIDEOBUF2_DMA_CONTIG_INGENIC
        bool "ingenic videobuf2 dma contig"
        depends on HAS_DMA
        select VIDEOBUF2_CORE
        select VIDEOBUF2_MEMOPS
        select DMA_SHARED_BUFFER
```

## module_drivers/drivers/media/platform/ingenic-cim/Kconfig
```kconfig
config VIDEO_INGENIC_CIM
	tristate "Ingenic Soc Camera Driver for X2000 && M300 && X1600 && X2600"
	select VIDEOBUF2_DMA_CONTIG_INGENIC
	select V4L2_FWNODE
	help
		CIM Driver for X2000 && M300 && X1600 && X2600

config CAMERA_USE_SNAPSHOT
	bool "Sensor support snapshot function"
	depends on VIDEO_INGENIC_CIM
	help
		Sensor support snapshot function

config SNAPSHOT_PULSE_WIDTH
        int "Snapshot pulse width"
        depends on CAMERA_USE_SNAPSHOT
        default 8
        help
          Snapshot pulse width

config SNAPSHOT_FRAME_DELAY
        int "One frame end delay"
        depends on CAMERA_USE_SNAPSHOT
        default 100
        help
          One frame end delay

menuconfig X2600_CAMERA_BOARD
	bool "x2600_camera_board"
	depends on VIDEO_INGENIC_CIM
	depends on SOC_X2600
	default n
	help
	  Say Y here to enable support for x2600_camera_boards.

config TUCANA_DVP_CAMERA
	bool "x2600_tucana camera driver for X2600_TUCANA_DVP_OV5640_CAMERA"
	depends on X2600_CAMERA_BOARD
	select INGENIC_CIM_CAMERA_OV5640

config	RD_X2600_DVP_CAMERA
	bool "x2600_camera driver for X2600_GC0308 DVP camera"
	depends on X2600_CAMERA_BOARD
	select INGENIC_CIM_CAMERA_DVP_GC0308

menuconfig PANDA_CAMERA_BOARD
	bool "panda_camera_board"
	depends on VIDEO_INGENIC_CIM
	depends on SOC_X1600
	default n
	help
	  Say Y here to enable support for panda_camera_boards.

config RD_X1600_PANDA_MIPI_CAMERA_1V0
	bool "panda camera driver for RD_X1600_PANDA_MIPI_CAMERA_1V0"
	depends on PANDA_CAMERA_BOARD
	select INGENIC_CIM_CAMERA_OV5645

config RD_X1600_PANDA_MIPI_CAMERA_2V0
	bool "panda camera driver for RD_X1600_PANDA_MIPI_CAMERA_2V0"
	depends on PANDA_CAMERA_BOARD
	select INGENIC_CIM_CAMERA_OV9281

config RD_X1600_PANDA_MIPI_CAMERA_3V2
	bool "panda camera driver for RD_X1600_PANDA_MIPI_CAMERA_3V2"
	depends on PANDA_CAMERA_BOARD
	select INGENIC_CIM_CAMERA_OV4689

config RD_X1600_PANDA_DVP_CAMERA_1V0
	bool "panda camera driver for RD_X1600_PANDA_DVP_CAMERA_V1.0"
	depends on PANDA_CAMERA_BOARD
	select INGENIC_CIM_CAMERA_SC031GS

config RD_X1600_PANDA_DVP_CAMERA_AND_LCD_1V0
	bool "panda camera driver for RD_X1600_PANDA_DVP_CAMERA_AND_LCD_V1.0"
	depends on PANDA_CAMERA_BOARD
	select INGENIC_CIM_CAMERA_OV5640

config RD_X1600_PANDA_DVP_CAMERA_2V0
	bool "panda camera driver for RD_X1600_PANDA_DVP_CAMERA_V2.0"
	depends on PANDA_CAMERA_BOARD
	select INGENIC_CIM_CAMERA_OV9281_DVP_SNAPSHOT

menuconfig HALLEY6_CAMERA_BOARD
	bool "halley6_camera_board"
	depends on VIDEO_INGENIC_CIM
	depends on SOC_X1600
	default n
	help
	  Say Y here to enable support for panda_camera_boards.

config RD_X1600_HALLEY6_MIPI_CAMERA
	bool "halley6 camera driver for RD_X1600_HALLEY6_MIPI_CAMERA"
	depends on HALLEY6_CAMERA_BOARD
	select INGENIC_CIM_CAMERA_MIPI_SC031GS

config RD_X1600_HALLEY6_DVP_CAMERA
	bool "halley6 camera driver for RD_X1600_HALLEY6_DVP_CAMERA"
	depends on HALLEY6_CAMERA_BOARD
	select INGENIC_CIM_CAMERA_SC031GS

menuconfig HALLEY5_CIM_CAMERA_BOARD
	bool "halley5_camera_board"
	depends on VIDEO_INGENIC_CIM
	depends on SOC_X2000
	default n
	help
	  Say Y here to enable support for halley5_camera_boards.


config RD_X2000_HALLEY5_CAMERA_CIM
	bool "halley5 camera driver for RD_X2000_HALLEY5_CAMERA_CIM"
	depends on HALLEY5_CIM_CAMERA_BOARD
	select INGENIC_CIM_CAMERA_AR0144
	select INGENIC_CIM_CAMERA_OV2735B
```
